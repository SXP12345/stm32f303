# file: ADC.ioc
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Mcu.Family=STM32F3
Mcu.Name=STM32F303V(B-C)Tx
Mcu.Package=LQFP100
NVIC.PriorityGroup=NVIC_PRIORITYGROUP_4
PA13.Mode=Serial_Wire
PA13.Signal=SYS_JTMS-SWDIO
PA14.Mode=Serial_Wire
PA14.Signal=SYS_JTCK-SWCLK
PF0-OSC_IN.Mode=HSE-External-Clock-Source
PF0-OSC_IN.Signal=RCC_OSC_IN
ProjectManager.HeapSize=0x200
ProjectManager.StackSize=0x400
ProjectManager.TargetToolchain=MDK-ARM V5.32
RCC.AHBFreq_Value=72000000
RCC.APB1CLKDivider=RCC_HCLK_DIV2
RCC.APB1Freq_Value=36000000
RCC.APB1TimFreq_Value=72000000
RCC.APB2Freq_Value=72000000
RCC.APB2TimFreq_Value=72000000
RCC.CortexFreq_Value=72000000
RCC.HCLKFreq_Value=72000000
RCC.HSE_VALUE=8000000
RCC.HSI_VALUE=8000000
RCC.LSE_VALUE=32768
RCC.PLLMUL=RCC_PLL_MUL9
RCC.PLLSourceVirtual=RCC_PLLSOURCE_HSE
RCC.SYSCLKFreq_VALUE=72000000
RCC.SYSCLKSourceVirtual=RCC_SYSCLKSOURCE_PLLCLK
RCC.USBFreq_Value=72000000
board=custom

// file: Core/Src/main.c
/* USER CODE BEGIN Header */
/**
  ******************************************************************************
  * @file           : main.c
  * @brief          : Main program body
  ******************************************************************************
  * @attention
  *
  * Copyright (c) 2022 STMicroelectronics.
  * All rights reserved.
  *
  * This software is licensed under terms that can be found in the LICENSE file
  * in the root directory of this software component.
  * If no LICENSE file comes with this software, it is provided AS-IS.
  *
  ******************************************************************************
  */
/* USER CODE END Header */
#include "main.h"
#include "gpio.h"

/* USER CODE BEGIN Includes */
#include "led_bsp.h"
#include "usart_bsp.h"
#include "adc_bsp.h"
/* USER CODE END Includes */

/* USER CODE BEGIN PV */
uint8_t ch[5];
uint8_t Rx_IT_Flag;
uint8_t ADC_IT_Flag;
uint32_t temp_adc;
float Avg_Slope = 4.0; // mV per degrees Celsius
float V25 = 1.34; // V
float temp;
__IO uint16_t VREFINT_CAL;
/* USER CODE END PV */

void SystemClock_Config(void);

int main(void)
{

  /* MCU Configuration--------------------------------------------------------*/

  /* Reset of all peripherals, Initializes the Flash interface and the Systick. */
  HAL_Init();

  /* Configure the system clock */
  SystemClock_Config();

  /* Initialize all configured peripherals */
  MX_GPIO_Init();
  /* USER CODE BEGIN 2 */
	LED_GPIO_Init();
	USART_Config();
	ADC_Config();
	printf("Hello World!\n");
	Rx_IT_Flag = 0;
	VREFINT_CAL = *(__IO uint16_t *)(0x1FFFF7BA);
  /* USER CODE END 2 */
  /* Infinite loop */
  while (1)
  {
    /* USER CODE BEGIN 3 */
	LED_LD8_TOGGLE;
	HAL_Delay(250);
	if(Rx_IT_Flag == 0)
	{
		HAL_UART_Receive_IT(&huart, ch, 2);
	}
	else if(Rx_IT_Flag == 1)
	{
		Rx_IT_Flag = 0;
		if(ch[0] == 'A')
		{
			LED_LD4_ON;
			LED_LD5_OFF;
			LED_LD7_OFF;
			HAL_ADC_Start_IT(&hadc);
			ADC_IT_Flag = 0;
		}
		else if(ch[0] == 'B')
		{
			LED_LD4_OFF;
			LED_LD5_ON;
			LED_LD7_OFF;
			HAL_ADC_Stop_IT(&hadc);
			ADC_IT_Flag = 0;
		}
		else
		{
			LED_LD4_OFF;
			LED_LD5_OFF;
			LED_LD7_ON;
		}
	}

	if(ADC_IT_Flag == 1)
	{
		ADC_IT_Flag = 0;
		temp_adc = HAL_ADC_GetValue(&hadc);
		temp = (float)temp_adc/4096*(float)2.973;
		//temp = (float)3.3*(float)VREFINT_CAL/(float)temp_adc;
		temp = (V25-temp)/Avg_Slope*1000+25;
		printf("temp = %.3f *C \r\n", temp);
	}
  }
  /* USER CODE END 3 */
}

void SystemClock_Config(void)
{
  RCC_OscInitTypeDef RCC_OscInitStruct = {0};
  RCC_ClkInitTypeDef RCC_ClkInitStruct = {0};

  /** Initializes the RCC Oscillators according to the specified parameters
  * in the RCC_OscInitTypeDef structure.
  */
  RCC_OscInitStruct.OscillatorType = RCC_OSCILLATORTYPE_HSE;
  RCC_OscInitStruct.HSEState = RCC_HSE_BYPASS;
  RCC_OscInitStruct.HSEPredivValue = RCC_HSE_PREDIV_DIV1;
  RCC_OscInitStruct.HSIState = RCC_HSI_ON;
  RCC_OscInitStruct.PLL.PLLState = RCC_PLL_ON;
  RCC_OscInitStruct.PLL.PLLSource = RCC_PLLSOURCE_HSE;
  RCC_OscInitStruct.PLL.PLLMUL = RCC_PLL_MUL9;
  if (HAL_RCC_OscConfig(&RCC_OscInitStruct) != HAL_OK)
  {
    Error_Handler();
  }

  /** Initializes the CPU, AHB and APB buses clocks
  */
  RCC_ClkInitStruct.ClockType = RCC_CLOCKTYPE_HCLK|RCC_CLOCKTYPE_SYSCLK
                              |RCC_CLOCKTYPE_PCLK1|RCC_CLOCKTYPE_PCLK2;
  RCC_ClkInitStruct.SYSCLKSource = RCC_SYSCLKSOURCE_PLLCLK;
  RCC_ClkInitStruct.AHBCLKDivider = RCC_SYSCLK_DIV1;
  RCC_ClkInitStruct.APB1CLKDivider = RCC_HCLK_DIV2;
  RCC_ClkInitStruct.APB2CLKDivider = RCC_HCLK_DIV1;

  if (HAL_RCC_ClockConfig(&RCC_ClkInitStruct, FLASH_LATENCY_2) != HAL_OK)
  {
    Error_Handler();
  }
}

void Error_Handler(void)
{
  __disable_irq();
  while (1)
  {
  }
}
